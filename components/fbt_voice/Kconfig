## components/fbt_voice/Kconfig
```kconfig
menu "FBT VOICE CONFIG"
    config USE_FBT_SCREEN_TOUCH
        bool "Enable touch screen"
        default n
    config USE_FBT_AUDIO_SAMPLE_RATE
        int "Audio sampling rate"
        default 24000
        help
            The audio sampling rate is required when exchanging offers with the peer device. If you are a device that has not gone through an audio encoder, you can keep it as default
    config USE_FBT_AUDIO_FRAME_DURATION
        int "Audio frame duration"
        default 60
        help
            The frame duration of the audio is required when exchanging offers with the peer device. If you are a device that has not gone through an audio encoder, you can keep it as default
    config FBT_SERVER_ADDRESS
        string "Server address"
        default "http://mcp-device.fbtai.cn"
        help
            The address of the server 

endmenu
```
